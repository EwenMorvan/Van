## MainPCB/VanManagement/main/Kconfig.projbuild
```kconfig
menu "Van Management Project Configuration"
    config ENABLE_PHYSICAL_SWITCH
        bool "Enable Physical Switch"
        default y
        help
          Enable support for the physical switch on the Main PCB.

    config ENABLE_VIRTUAL_SWITCH_UART
        bool "Enable Virtual Switch (UART)"
        default n
        help
          Enable a virtual switch interface exposed over UART.
endmenu
```

## MainPCB/VanManagement/sdkconfig.defaults
```kconfig
# ESP32-S3 Configuration
CONFIG_IDF_TARGET="esp32s3"

# Bootloader config
CONFIG_BOOTLOADER_LOG_LEVEL_INFO=y

# Serial flasher config
CONFIG_ESPTOOLPY_FLASHMODE_QIO=y
CONFIG_ESPTOOLPY_FLASHFREQ_80M=y
CONFIG_ESPTOOLPY_FLASHSIZE_8MB=y

# Partition Table
CONFIG_PARTITION_TABLE_CUSTOM=y
CONFIG_PARTITION_TABLE_CUSTOM_FILENAME="partitions.csv"

# Component config
CONFIG_FREERTOS_HZ=1000
CONFIG_ESP_TASK_WDT_CHECK_IDLE_TASK_CPU0=n
CONFIG_ESP_TASK_WDT_CHECK_IDLE_TASK_CPU1=n

# Log output
CONFIG_LOG_DEFAULT_LEVEL_INFO=n
CONFIG_LOG_MAXIMUM_LEVEL_DEBUG=n

# Bluetooth - Use NimBLE for BLE 5.0 support
CONFIG_BT_ENABLED=y
CONFIG_BT_NIMBLE_ENABLED=y
# CONFIG_BT_BLUEDROID_ENABLED is not set
CONFIG_BT_BLE_ENABLED=y

# Ethernet
CONFIG_ETH_ENABLED=y
CONFIG_ETH_USE_SPI_ETHERNET=y

# ADC
CONFIG_ADC_ONESHOT_CTRL_FUNC_IN_IRAM=y

# RMT
CONFIG_RMT_ISR_IRAM_SAFE=y

# USB OTG
CONFIG_USB_OTG_SUPPORTED=y

# LEDC
CONFIG_LEDC_CTRL_FUNC_IN_IRAM=y
```

## SlavePCB/WaterManagment/main/Kconfig.projbuild
```kconfig
menu "SlavePCB Configuration"

    config SLAVEPCB_ENABLE_DEBUG_LOGS
        bool "Enable debug logging"
        default y
        help
            Enable debug level logging for SlavePCB components.

    config SLAVEPCB_BUTTON_DEBOUNCE_MS
        int "Button debounce time (ms)"
        range 10 1000
        default 50
        help
            Time in milliseconds for button debouncing.

    config SLAVEPCB_LONG_CLICK_MS
        int "Long click threshold (ms)"
        range 500 5000
        default 1000
        help
            Time in milliseconds to distinguish between short and long clicks.

    config SLAVEPCB_HX711_SAMPLES
        int "HX711 samples for averaging"
        range 1 50
        default 10
        help
            Number of samples to take for weight averaging.

    config SLAVEPCB_TANK_READ_INTERVAL_MS
        int "Tank reading interval (ms)"
        range 500 10000
        default 2000
        help
            Interval between tank weight readings.

    config SLAVEPCB_I2C_FREQ_HZ
        int "I2C frequency (Hz)"
        range 10000 400000
        default 100000
        help
            I2C bus frequency for current sensors.

    config SLAVEPCB_W5500_IP
        string "W5500 IP Address"
        default "192.168.1.100"
        help
            IP address for the W5500 Ethernet controller.

    config SLAVEPCB_MAINPCB_IP
        string "MainPCB IP Address"
        default "192.168.1.50"
        help
            IP address of the MainPCB to communicate with.

    config SLAVEPCB_COMM_PORT
        int "Communication port"
        range 1024 65535
        default 8080
        help
            TCP port for communication with MainPCB.

endmenu

menu "WiFi OTA Configuration"

    config WIFI_SSID
        string "WiFi SSID"
        default "van_wifi"
        help
            SSID (network name) for the WiFi network to connect to.

    config WIFI_PASSWORD
        string "WiFi Password"
        default "van123456"
        help
            WiFi password (WPA or WPA2).

    config WIFI_MAXIMUM_RETRY
        int "Maximum retry"
        default 5
        help
            Set the Maximum retry to avoid station reconnecting to the AP unlimited when the AP is really inexistent.

    config OTA_SERVER_IP
        string "OTA Server IP"
        default "192.168.1.10"
        help
            IP address of the OTA update server.

    config OTA_SERVER_PORT
        int "OTA Server Port"
        range 1024 65535
        default 8080
        help
            Port for OTA updates.

    config OTA_FILENAME
        string "OTA Firmware Filename"
        default "/WaterManagment.bin"
        help
            Filename of the firmware binary on the OTA server.

    config OTA_AUTO_UPDATE
        bool "Enable automatic OTA updates"
        default n
        help
            Enable automatic checking and updating from OTA server.

    config OTA_UPDATE_INTERVAL_MINUTES
        int "OTA Update Check Interval (minutes)"
        depends on OTA_AUTO_UPDATE
        range 5 1440
        default 60
        help
            Interval in minutes to check for OTA updates.

endmenu
```

## SlavePCB/WaterManagment/sdkconfig.defaults
```kconfig
CONFIG_ESPTOOLPY_FLASHMODE_QIO=y
CONFIG_ESPTOOLPY_FLASHSIZE_16MB=y
CONFIG_PARTITION_TABLE_CUSTOM=y
CONFIG_PARTITION_TABLE_CUSTOM_FILENAME="partitions.csv"

# ESP32S3 specific
CONFIG_IDF_TARGET_ESP32S3=y
CONFIG_ESP32S3_DEFAULT_CPU_FREQ_240=y

# FreeRTOS
CONFIG_FREERTOS_HZ=1000
CONFIG_FREERTOS_TASK_STACK_DEPTH_TYPE_BYTES=y

# Ethernet
CONFIG_ETH_USE_SPI_ETHERNET=y
CONFIG_ETH_SPI_ETHERNET_W5500=y

# SPI
CONFIG_SPI_FLASH_WRITING_DANGEROUS_REGIONS_ABORTS=n

# I2C
CONFIG_I2C_ENABLE_DEBUG_LOG=y

# Logging
CONFIG_LOG_DEFAULT_LEVEL_INFO=y
CONFIG_LOG_COLORS=y

# Task Watchdog
CONFIG_ESP_TASK_WDT=y
CONFIG_ESP_TASK_WDT_TIMEOUT_S=10
CONFIG_ESP_TASK_WDT_CHECK_IDLE_TASK_CPU0=y
CONFIG_ESP_TASK_WDT_CHECK_IDLE_TASK_CPU1=y

# Component config
CONFIG_ESP_SYSTEM_EVENT_QUEUE_SIZE=32
CONFIG_ESP_SYSTEM_EVENT_TASK_STACK_SIZE=4096

# Network
CONFIG_LWIP_SO_REUSE=y
CONFIG_LWIP_SO_REUSE_RXTOALL=y

# WiFi Configuration
CONFIG_ESP_WIFI_ENABLED=y
CONFIG_ESP_WIFI_STATIC_RX_BUFFER_NUM=10
CONFIG_ESP_WIFI_DYNAMIC_RX_BUFFER_NUM=32
CONFIG_ESP_WIFI_TX_BUFFER_TYPE_DYNAMIC=y
CONFIG_ESP_WIFI_DYNAMIC_TX_BUFFER_NUM=32
CONFIG_ESP_WIFI_AMPDU_TX_ENABLED=y
CONFIG_ESP_WIFI_AMPDU_RX_ENABLED=y

# OTA Configuration
CONFIG_APP_ROLLBACK_ENABLE=y
CONFIG_BOOTLOADER_APP_ROLLBACK_ENABLE=y
CONFIG_APP_ANTI_ROLLBACK=y

# HTTP Server Configuration
CONFIG_HTTPD_MAX_REQ_HDR_LEN=1024
CONFIG_HTTPD_MAX_URI_LEN=512
CONFIG_HTTPD_ERR_RESP_NO_DELAY=y
CONFIG_HTTPD_PURGE_BUF_LEN=32
CONFIG_HTTPD_SERVER_EVENT_POST_TIMEOUT=5000

# TCP/IP Stack optimizations for HTTP stability
CONFIG_LWIP_TCP_RECVMBOX_SIZE=8
CONFIG_LWIP_TCP_SND_BUF_DEFAULT=8192
CONFIG_LWIP_TCP_WND_DEFAULT=8192
CONFIG_LWIP_TCP_MSS=1460
CONFIG_LWIP_TCP_TMR_INTERVAL=125
CONFIG_LWIP_MAX_SOCKETS=12

# mDNS Configuration
CONFIG_MDNS_MAX_SERVICES=10
CONFIG_MDNS_TASK_PRIORITY=1
CONFIG_MDNS_TASK_STACK_SIZE=4096

# Extended Watchdog for OTA
CONFIG_ESP_TASK_WDT_TIMEOUT_S=60
CONFIG_ESP_INT_WDT_TIMEOUT_MS=800

# Partition Table for OTA
CONFIG_PARTITION_TABLE_TWO_OTA=n

# OTA Server Configuration
CONFIG_OTA_SERVER_PORT=8080
# Enable Bluetooth
CONFIG_BT_ENABLED=y
CONFIG_BT_CONTROLLER_ENABLED=y
CONFIG_BT_BLUEDROID_ENABLED=y
CONFIG_BT_BLE_ENABLED=y
CONFIG_BT_GATTS_ENABLE=y
CONFIG_BT_GATTC_ENABLE=y
CONFIG_BT_BTC_TASK_STACK_SIZE=8192

# Disable Classic Bluetooth to save memory
CONFIG_BT_CLASSIC_ENABLED=n
CONFIG_BT_A2DP_ENABLE=n
CONFIG_BT_SPP_ENABLED=n

# BLE Settings
CONFIG_BT_BLE_SMP_ENABLE=y
CONFIG_BT_STACK_NO_LOG=n
```

## video_projector/main/Kconfig.projbuild
```kconfig
menu "Video Projector Configuration"

    orsource "$IDF_PATH/examples/common_components/env_caps/$IDF_TARGET/Kconfig.env_caps"

    menu "Motor DC"
        config MOTOR_TURNS_COMPLETE_TRAVEL
            int "Encoder turns for complete travel (x100)"
            default 1000
            range 10 10000
            help
                Number of encoder turns needed for complete travel (x100).
                Example: 10.0 turns = 1000 (divide by 100 in code)

        config MOTOR_GEAR_RATIO
            int "Motor gear ratio (x10)"
            default 1000
            range 10 10000
            help
                Gear reduction ratio of motor (x10).
                Example: 100.0 = 1000 (divide by 10 in code)
    endmenu

    menu "BLE Parameters"
        config BLE_DEVICE_NAME
            string "BLE device name"
            default "VideoProjector_Van"
            help
                Name visible during BLE discovery (max 31 chars).

        config BLE_BROADCAST_INTERVAL
            int "BLE advertising interval (ms)"
            default 500
            range 100 10000
            help
                Advertising interval in milliseconds.
    endmenu

    menu "Button and LED"
        config BUTTON_DEBOUNCE_MS
            int "Button debounce time (ms)"
            default 50
            range 10 200
            help
                Wait time to confirm button press.

        config BUTTON_LONG_PRESS_MS
            int "Long press duration (ms)"
            default 1000
            range 500 5000
            help
                Minimum duration to consider as long press.
    endmenu

    menu "IR LED"
        config IR_FREQUENCY_HZ
            int "IR carrier frequency (Hz)"
            default 38000
            range 1000 56000
            help
                Standard carrier frequency is 38000 Hz.

        config IR_DUTY_CYCLE
            int "IR PWM duty cycle (%)"
            default 50
            range 10 90
            help
                PWM duty cycle for IR LED signal.
    endmenu

endmenu
```

## video_projector/sdkconfig.defaults
```kconfig
CONFIG_BLINK_LED_GPIO=y
CONFIG_BLINK_GPIO=8

# =====================================================================
# Configuration pour ESP32-C3 Xiao - Système Vidéoprojecteur
# =====================================================================

# Enable Bluetooth & BLE (NimBLE is built-in to ESP-IDF)
CONFIG_BT_ENABLED=y
CONFIG_BT_NIMBLE_ENABLED=y
CONFIG_BT_CONTROLLER_MODE_BLE_ONLY=y
CONFIG_BT_NIMBLE_MAX_CONNECTIONS=1
CONFIG_BT_NIMBLE_GAP_DEVICE_NAME_MAX_LENGTH=31

# ESP32-C3 BT Controller
CONFIG_BTDM_CTRL_MODE_BLE_ONLY=y
CONFIG_BTDM_CTRL_MODE_BR_EDR_ONLY=n
CONFIG_BTDM_CTRL_MODE_BTDM=n

# NimBLE specific
CONFIG_BT_NIMBLE_MEM_ALLOC_MODE_INTERNAL=y
CONFIG_BT_NIMBLE_HOST_TASK_STACK_SIZE=4096
CONFIG_BT_NIMBLE_TASK_STACK_SIZE=4096

# Logs
CONFIG_LOG_DEFAULT_LEVEL=3
CONFIG_LOG_MAXIMUM_LEVEL=5

# FreeRTOS
CONFIG_FREERTOS_HZ=1000

# GPIO - Fonctions critiques en IRAM
CONFIG_GPIO_CTRL_FUNC_IN_IRAM=y

# Optimisations
CONFIG_COMPILER_OPTIMIZATION_SIZE=y
CONFIG_COMPILER_OPTIMIZATION_ASSERTIONS_ENABLE=y

# UART/Console
CONFIG_ESP_CONSOLE_UART_DEFAULT=y
CONFIG_ESP_CONSOLE_UART_NUM=0

# Heap
CONFIG_HEAP_TASK_TRACKING=y
```
